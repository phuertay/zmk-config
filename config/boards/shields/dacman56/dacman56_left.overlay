// dacman56_left.overlay

#include "dacman56.dtsi" // Notice that the main dtsi files are included in the overlay.

&kscan0 {
    col-gpios
		= <&pro_micro_d 4 GPIO_ACTIVE_HIGH>
		, <&pro_micro_d 5 GPIO_ACTIVE_HIGH>
		, <&pro_micro_d 6 GPIO_ACTIVE_HIGH>
		, <&pro_micro_d 7 GPIO_ACTIVE_HIGH>
		, <&pro_micro_d 8 GPIO_ACTIVE_HIGH>
		, <&pro_micro_d 9 GPIO_ACTIVE_HIGH>
		;
};